## main/Kconfig.projbuild
```kconfig
menu "Example Configuration"
    config EXAMPLE_RMT_TX_GPIO
        int "RMT TX GPIO"
        default 38
        help
            Set the GPIO number used for transmitting the RMT signal.

    config EXAMPLE_LED_STRIP_GPIO
        int "LED STRIP GPIO"
        default 48
        help
            Set the GPIO number used for transmitting the RMT signal.

    config EXAMPLE_STRIP_LED_NUMBER
        int "Number of LEDS in a strip"
        default 12
        help
            A single RGB strip contains several LEDs.

    config EXAMPLE_WIFI_SSID
        string "WiFi SSID"
        default "myssid"
        help
            Set the SSID of the WiFi network to connect to.
    
    config EXAMPLE_WIFI_PASSWORD
        string "WiFi Password"
        default "mypassword"
        help
            Set the password of the WiFi network to connect to.
endmenu
```

## sdkconfig.defaults
```kconfig
CONFIG_EXAMPLE_STRIP_LED_NUMBER=1
CONFIG_EXAMPLE_RMT_TX_GPIO=38
CONFIG_EXAMPLE_WIFI_SSID="ChinaNet-fLUc"
CONFIG_EXAMPLE_WIFI_PASSWORD="sweetyhouse@75"

CONFIG_IDF_TARGET="esp32s3"
CONFIG_IDF_TARGET_ESP32S3=y
CONFIG_ESPTOOLPY_FLASHMODE_QIO=y
CONFIG_ESPTOOLPY_FLASHSIZE_16MB=y
CONFIG_PARTITION_TABLE_CUSTOM=y
CONFIG_PARTITION_TABLE_CUSTOM_FILENAME="partitions.csv"
CONFIG_PARTITION_TABLE_FILENAME="partitions.csv"
CONFIG_PARTITION_TABLE_OFFSET=0x8000
CONFIG_ESP32S3_DEFAULT_CPU_FREQ_240=y
CONFIG_ESP32S3_INSTRUCTION_CACHE_32KB=y
CONFIG_ESP32S3_DATA_CACHE_64KB=y
CONFIG_ESP32S3_DATA_CACHE_LINE_64B=y
CONFIG_ESP32S3_SPIRAM_SUPPORT=y
CONFIG_SPIRAM_MODE_OCT=y
CONFIG_SPIRAM_SPEED_80M=y
# CONFIG_ESP_SYSTEM_PANIC_PRINT_HALT is not set
CONFIG_ESP_SYSTEM_PANIC_PRINT_REBOOT=y
# CONFIG_ESP_SYSTEM_PANIC_SILENT_REBOOT is not set
# CONFIG_ESP_SYSTEM_PANIC_GDBSTUB is not set
# CONFIG_ESP_SYSTEM_GDBSTUB_RUNTIME is not set
CONFIG_ESP_SYSTEM_RTC_FAST_MEM_AS_HEAP_DEPCHECK=y
CONFIG_ESP_SYSTEM_ALLOW_RTC_FAST_MEM_AS_HEAP=y

CONFIG_USE_AFE=y
CONFIG_AFE_INTERFACE_V1=y
CONFIG_USE_WAKENET=y
CONFIG_USE_MULTINET=n
CONFIG_SR_WN_LOAD_MULIT_WORD=y

#
# Load Multiple Wake Words
#
CONFIG_SR_WN_WN9_HILEXIN_MULTI=y
CONFIG_SR_WN_WN9_HIESP_MULTI=y

CONFIG_LV_DISPLAY_ORIENTATION=5
CONFIG_LV_TFT_DISPLAY_USER_CONTROLLER_ST7789=y
CONFIG_LV_TFT_DISPLAY_SPI_HSPI=y
# CONFIG_LV_TFT_DISPLAY_SPI_VSPI is not set
CONFIG_LV_TFT_DISPLAY_SPI_TRANS_MODE_SIO=y
# CONFIG_LV_TFT_DISPLAY_SPI_TRANS_MODE_DIO is not set
# CONFIG_LV_TFT_DISPLAY_SPI_TRANS_MODE_QIO is not set
CONFIG_LV_TFT_DISPLAY_SPI_HALF_DUPLEX=y
# CONFIG_LV_TFT_DISPLAY_SPI_FULL_DUPLEX is not set
# CONFIG_LV_TFT_USE_CUSTOM_SPI_CLK_DIVIDER is not set
CONFIG_LV_TFT_CUSTOM_SPI_CLK_DIVIDER=2
# CONFIG_LV_INVERT_COLORS is not set

CONFIG_LV_DISP_SPI_MOSI=11
# CONFIG_LV_DISPLAY_USE_SPI_MISO is not set
CONFIG_LV_DISP_SPI_CLK=12
CONFIG_LV_DISPLAY_USE_SPI_CS=y
CONFIG_LV_DISP_SPI_CS=10
CONFIG_LV_DISPLAY_USE_DC=y
CONFIG_LV_DISP_PIN_DC=9
CONFIG_LV_DISP_USE_RST=y
CONFIG_LV_DISP_PIN_RST=4

CONFIG_LV_I2C_DISPLAY_PORT=0

CONFIG_LV_TOUCH_CONTROLLER=1
# CONFIG_LV_TOUCH_CONTROLLER_NONE is not set
CONFIG_LV_TOUCH_CONTROLLER_XPT2046=y
# CONFIG_LV_TOUCH_CONTROLLER_FT6X06 is not set
# CONFIG_LV_TOUCH_CONTROLLER_STMPE610 is not set
# CONFIG_LV_TOUCH_CONTROLLER_ADCRAW is not set
# CONFIG_LV_TOUCH_CONTROLLER_FT81X is not set
# CONFIG_LV_TOUCH_CONTROLLER_RA8875 is not set
# CONFIG_LV_TOUCH_CONTROLLER_GT911 is not set
CONFIG_LV_TOUCH_DRIVER_PROTOCOL_SPI=y
# CONFIG_LV_TOUCH_CONTROLLER_SPI_HSPI is not set
CONFIG_LV_TOUCH_CONTROLLER_SPI_VSPI=y

#
# Touchpanel (XPT2046) Pin Assignments
#
CONFIG_LV_TOUCH_SPI_MISO=13
CONFIG_LV_TOUCH_SPI_MOSI=11
CONFIG_LV_TOUCH_SPI_CLK=12
CONFIG_LV_TOUCH_SPI_CS=46
CONFIG_LV_TOUCH_PIN_IRQ=2
```
